## firmware/main/Kconfig.projbuild
```kconfig
menu "GridShield Configuration"

    config GRIDSHIELD_DEMO_MODE
        bool "Enable QEMU Simulation Mode (disable for real hardware)"
        default n
        help
            When disabled (default): Production mode — ESP32 runs with real
            sensors, WiFi, and full security pipeline.
            When enabled: QEMU simulation mode with mock platform.

    config GRIDSHIELD_WIFI_SSID
        string "WiFi SSID"
        default "YOUR_WIFI_SSID"
        help
            WiFi network name to connect to.

    config GRIDSHIELD_WIFI_PASS
        string "WiFi Password"
        default "YOUR_WIFI_PASSWORD"
        help
            WiFi network password.

    config GRIDSHIELD_BACKEND_HOST
        string "Backend Server IP Address"
        default "192.168.1.100"
        help
            IP address of the machine running the GridShield FastAPI backend.
            Use your computer's local IP (e.g. 192.168.1.100).

    config GRIDSHIELD_BACKEND_PORT
        int "Backend Server Port"
        default 8000
        help
            Port number of the GridShield FastAPI backend (default: 8000).

endmenu
```
