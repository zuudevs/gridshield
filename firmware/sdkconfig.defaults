## firmware/sdkconfig.defaults
```kconfig
# GridShield Firmware - SDK Config Defaults
# These are applied before sdkconfig overrides

# === Build Target ===
CONFIG_IDF_TARGET="esp32"

# === C++ Standard ===
CONFIG_COMPILER_CXX_EXCEPTIONS=n
CONFIG_COMPILER_CXX_RTTI=n

# === Log Level ===
CONFIG_LOG_DEFAULT_LEVEL_INFO=y
CONFIG_LOG_MAXIMUM_LEVEL_DEBUG=y

# === NVS ===
CONFIG_NVS_COMPATIBLE_ENCRYPTION=n

# === Security: Secure Boot v2 (enable on real hardware) ===
# CONFIG_SECURE_BOOT=y
# CONFIG_SECURE_BOOT_V2_ENABLED=y
# CONFIG_SECURE_BOOT_SIGNING_KEY="signing_key.pem"
# CONFIG_SECURE_SIGNED_ON_BOOT=y
# CONFIG_SECURE_SIGNED_ON_UPDATE=y

# === Security: Flash Encryption (enable on real hardware) ===
# CONFIG_SECURE_FLASH_ENC_ENABLED=y
# CONFIG_SECURE_FLASH_ENCRYPTION_MODE_DEVELOPMENT=y

# === Security: NVS Encryption ===
# CONFIG_NVS_ENCRYPTION=y
```
